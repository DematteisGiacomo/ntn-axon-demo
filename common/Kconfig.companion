## common/Kconfig.companion
```kconfig
# Copyright (c) 2026 Nordic Semiconductor ASA
# SPDX-License-Identifier: LicenseRef-Nordic-5-Clause
#
# Must match on nRF54 (sender) and nRF9151 (receiver) for a given build.

menu "Companion thumbnail"

config COMPANION_CHUNKED_NTN
	bool "Split full thumbnail into multiple NTN-sized UDP packets"
	default y
	help
	  UART carries each chunk as its own AXF1 frame; nRF9151 sends them
	  sequentially on one NTN attach. Server reassembles by frame_id.

if COMPANION_CHUNKED_NTN

config COMPANION_CHUNK_COUNT
	int "Number of NTN UDP packets per image"
	default 4
	range 2 16

config COMPANION_CHUNK_BYTES
	int "Image payload bytes per chunk (AXF1 image_len)"
	default 1024
	range 64 2024

config COMPANION_THUMB_FULL_W
	int "Full thumbnail width (pixels)"
	default 64

config COMPANION_THUMB_FULL_H
	int "Full thumbnail height (pixels)"
	default 64

config COMPANION_THUMB_BYTES
	int
	default COMPANION_CHUNK_BYTES

config COMPANION_THUMB_W
	int
	default COMPANION_THUMB_FULL_W

config COMPANION_THUMB_H
	int
	default COMPANION_THUMB_FULL_H

config COMPANION_REASSEMBLY_BYTES
	int "Full image payload bytes (W x H)"
	default 4096
	help
	  Must equal COMPANION_THUMB_FULL_W times COMPANION_THUMB_FULL_H and
	  COMPANION_CHUNK_COUNT times COMPANION_CHUNK_BYTES (checked at build time).

endif # COMPANION_CHUNKED_NTN

if !COMPANION_CHUNKED_NTN

choice COMPANION_THUMB_SIZE
	prompt "Luma payload size (AXF1 image bytes)"
	default COMPANION_THUMB_SIZE_256
	help
	  UDP/UART wire size is 24 bytes + this value (header + CRC).
	  Use the same choice when building app-person and asset-tracker-template.

config COMPANION_THUMB_SIZE_256
	bool "256 bytes (16x16)"

config COMPANION_THUMB_SIZE_512
	bool "512 bytes (32x16)"

config COMPANION_THUMB_SIZE_768
	bool "768 bytes (32x24)"

config COMPANION_THUMB_SIZE_1024
	bool "1024 bytes (32x32)"

endchoice

config COMPANION_THUMB_BYTES
	int
	default 256 if COMPANION_THUMB_SIZE_256
	default 512 if COMPANION_THUMB_SIZE_512
	default 768 if COMPANION_THUMB_SIZE_768
	default 1024 if COMPANION_THUMB_SIZE_1024

config COMPANION_THUMB_W
	int
	default 16 if COMPANION_THUMB_SIZE_256
	default 32 if COMPANION_THUMB_SIZE_512
	default 32 if COMPANION_THUMB_SIZE_768
	default 32 if COMPANION_THUMB_SIZE_1024

config COMPANION_THUMB_H
	int
	default 16 if COMPANION_THUMB_SIZE_256
	default 16 if COMPANION_THUMB_SIZE_512
	default 24 if COMPANION_THUMB_SIZE_768
	default 32 if COMPANION_THUMB_SIZE_1024

endif # !COMPANION_CHUNKED_NTN

endmenu
```
